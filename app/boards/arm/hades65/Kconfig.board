## app/boards/arm/hades65/Kconfig.board
```kconfig
# Zaphod board configuration

# Copyright (c) 2020 Pete Johanson
# SPDX-License-Identifier: MIT

config BOARD_HADES65
	bool "Hades65"
	depends on SOC_NRF52840_QIAA
```

## app/boards/arm/hades65/Kconfig.defconfig
```kconfig
# Copyright (c) 2020 Pete Johanson
# SPDX-License-Identifier: MIT

if BOARD_HADES65

config BOARD
	default "hades65"

config ZMK_KEYBOARD_NAME
	default "Hades 65 Ble"

if USB

config USB_NRFX
	default y

config USB_DEVICE_STACK
	default y

endif # USB

config BT_CTLR
	default BT

config ZMK_BLE
	default y

config ZMK_USB
	default y

config ZMK_BATTERY_VOLTAGE_DIVIDER
	default y

endif # BOARD_HADES65
```
